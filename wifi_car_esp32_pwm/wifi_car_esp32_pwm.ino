/**
 NodeMCU-32S, ESP32 support WiFi/Bluetooth w/o CAM, 
 BlueTooth / WiFi RC Car 0.1 
 2021/04/18 added BlueTooth support.
 2021/04/18 Use ESP32 WRover Module, Partition size schemem : HUGE App.
 2021/04/18 Added OLED support. Display connected IP address.
 2021/04/24 Add WiFi connection time out and show BT only on OLED.
 2021/05/28 Add new LED cmd for Red(U) Yellow(V) Green(W) All_ON(Y), All_OFF(Z)

 GPIO#22 SCL
 GPIO#21 SDA
 GPIO#32 IN1
 GPIO#33 IN2
 GPIO#25 IN3
 GPIO#26 IN4
 GPIO#13 LED_RED
 GPIO#14 LED_BLUE
*/

#include <WiFi.h>
#include <WebServer.h>
#include "BluetoothSerial.h"

#include <Arduino.h>
#include <U8g2lib.h>

// set CAR type
#define BT_CAR_M1Y 1
//#define BT_CAR_M1B 1
//#define BT_CAR_M1L 1

#define ESP32_SCL 22
#define ESP32_SDA 21
U8G2_SSD1306_128X64_NONAME_1_SW_I2C u8g2(U8G2_R0, /* clock=*/ESP32_SCL, /* data=*/ESP32_SDA, /* reset=*/ U8X8_PIN_NONE);  //ESP8266板子搭配SSD1306用這行

#define imgWidth 128
#define imgHeight 48  // use 48 for imge, the header in 16 is for text output.

static const unsigned char PROGMEM android[] = {
0x00, 0x00, 0x00, 0x00, 0x00, 0x00, 0x00, 0x00, 0x00, 0x00, 0x00, 0x00, 0x00, 0x00, 0x00, 0x00,
0x00, 0x00, 0x00, 0x00, 0x00, 0x00, 0x10, 0x00, 0x00, 0x08, 0x00, 0x00, 0x00, 0x00, 0x00, 0x00,
0x00, 0x00, 0x00, 0x00, 0x00, 0x00, 0x20, 0x00, 0x00, 0x04, 0x00, 0x00, 0x00, 0x00, 0x00, 0x00,
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0x00, 0x00, 0x00, 0x00, 0x00, 0x00, 0x00, 0x00, 0x00, 0x00, 0x00, 0x00, 0x00, 0x00, 0x00, 0x00,};

BluetoothSerial SerialBT;

const char *ssid = "YOUR_SSID";
const char *password = "YOUR_PASSWORD";

IPAddress ip(192, 168, 4, 1);
IPAddress netmask(255, 255, 255, 0);
const int port = 80; // Port
WebServer server(port);


// Not USED. Reserved. 2021/04/24 define L9110s PWM pin.
#define B_1A 32  // B_1A控制B馬達的前進（HIGH）、後退（LOW）
#define B_1B 33  // B_1B控制B馬達的速度 0~255，LOW表示停止
#define A_1A 25  // A_1A控制A馬達的前進（HIGH）、後退（LOW）
#define A_1B 26  // A_1B控制A馬達的速度 0~255 ，LOW表示停止

#define Speed 150 //設定前進速度

// setting PWM properties
const int freq = 5000;
const int ledChannel = 0;
const int resolution = 8;



#ifdef BT_CAR_M1B
#define BT_NAME "WiFi_BT_Car"
#endif

#ifdef BT_CAR_M1Y
#define BT_NAME "WiFi_BT_CarY"
#endif

#ifdef BT_CAR_M1L
#define BT_NAME "ESPBTLed_01"
#endif

#ifdef BT_CAR_M1B
#define IN1 32
#define IN2 33
#define IN3 25
#define IN4 26

#define SP10 92
#define SP9 86
#define SP8 80
#define SP7 74
#define SP6 68
#define SP5 62
#define SP4 56
#define SP3 50
#define SP2 44
#define SP1 38
#define SP0 32

int CAR_STATE=0;
#define CAR_FORWARD 1
#define CAR_BACK    2
#define CAR_LEFT    3
#define CAR_RIGHT   4
#define CAR_STOP    0

#define LED_YELLOW 12
#define LED_RED   13
#define LED_BLUE  14
int LED_BUILTIN = 16;
#endif

#ifdef BT_CAR_M1L
#define IN1 32
#define IN2 33
#define IN3 25
#define IN4 26

#define SP10 92
#define SP9 86
#define SP8 80
#define SP7 74
#define SP6 68
#define SP5 62
#define SP4 56
#define SP3 50
#define SP2 44
#define SP1 38
#define SP0 32

int CAR_STATE=0;
#define CAR_FORWARD 1
#define CAR_BACK    2
#define CAR_LEFT    3
#define CAR_RIGHT   4
#define CAR_STOP    0

#define LED_YELLOW 12
#define LED_RED   14
#define LED_BLUE  13
int LED_BUILTIN = 16;
#endif

#ifdef BT_CAR_M1Y
#define IN1 33
#define IN2 32
#define IN3 26
#define IN4 25

#define SP10 92
#define SP9 86
#define SP8 80
#define SP7 74
#define SP6 68
#define SP5 62
#define SP4 56
#define SP3 50
#define SP2 44
#define SP1 38
#define SP0 32

int CAR_STATE=0;
#define CAR_FORWARD 1
#define CAR_BACK    2
#define CAR_LEFT    3
#define CAR_RIGHT   4
#define CAR_STOP    0

#define LED_YELLOW 12
#define LED_RED   13
#define LED_BLUE  15
int LED_BUILTIN = 16;
#endif


int motor_speed = 1024;

void setup() {

  Serial.begin(115200);
  SerialBT.begin(BT_NAME); //Bluetooth device name
  Serial.println("The device started, now you can pair it with bluetooth!");

  Serial.print("WiFi Connecting to : ");
  Serial.println(ssid);

  pinMode(LED_BUILTIN, OUTPUT);

  pinMode(A_1A, OUTPUT);
  pinMode(A_1B, OUTPUT);
  pinMode(B_1A, OUTPUT);
  pinMode(B_1B, OUTPUT);

  //ledcAttachPin(A_1B, 1); // assign RGB led pins to channels
  //ledcAttachPin(B_1B, 2);

  //ledcSetup(1, 500, 8); // 12 kHz PWM, 8-bit resolution
  //ledcSetup(2, 500, 8);

  //ledcWrite(1, 255);
  //ledcWrite(2, 255);

  pinMode(LED_RED, OUTPUT);
  pinMode(LED_BLUE, OUTPUT);
  pinMode(LED_YELLOW, OUTPUT);

  u8g2.begin();

  WiFi.persistent(false);
  WiFi.mode(WIFI_OFF);
  WiFi.mode(WIFI_STA);

  WiFi.disconnect();
  WiFi.begin(ssid, password);

  unsigned long startTime, endTime;

  startTime = millis();

  while (WiFi.status() != WL_CONNECTED) {
    pinMode(LED_BUILTIN, LOW);
    delay(250);
    pinMode(LED_BUILTIN, HIGH);
    delay(250);
    Serial.print(".");

    endTime = millis();
    Serial.print(String(endTime-startTime));
    if ((endTime-startTime) >= 10000)
      break;
  }

  if (WiFi.status() == WL_CONNECTED) {
    Serial.println("Connection established!");
    Serial.print("IP address: ");
    Serial.println(WiFi.localIP());
  }

  //u8g2.setFont(u8g2_font_HelvetiPixelOutline_te); //set font
  u8g2.setFont(u8g2_font_helvB12_te);
  u8g2.firstPage();
  do {
      if (WiFi.status() == WL_CONNECTED)
        u8g2.drawStr(0, 13, WiFi.localIP().toString().c_str()); //output msg
      else
        u8g2.drawStr(0, 13, BT_NAME);

      u8g2.drawXBMP(0,16, imgWidth, imgHeight, android);        //show image
  } while ( u8g2.nextPage() );

  server.on("/move", HTTP_GET, handleMoveRequest);
  server.on("/action", HTTP_GET, handleActionRequest);
  server.onNotFound(handleNotFound);
  server.begin();
}

void MotorUp()  {
  if (CAR_STATE==CAR_FORWARD)  return;
  CAR_STATE=CAR_FORWARD;
  Serial.println("Motor::Up");
  digitalWrite(IN1, HIGH);
  digitalWrite(IN2, LOW);
  digitalWrite(IN3, HIGH);
  digitalWrite(IN4, LOW);

  //ledcWrite(1, 255);
  //ledcWrite(2, 255);
  //MotorStop();
}

void MotorDown() {
  if (CAR_STATE==CAR_BACK)  return;
  CAR_STATE=CAR_BACK;
  Serial.println("Motor::Down");
  digitalWrite(IN1, LOW);
  digitalWrite(IN2, HIGH);
  digitalWrite(IN3, LOW);
  digitalWrite(IN4, HIGH);

  //ledcWrite(1, 255);
  //ledcWrite(2, 255);
  //MotorStop();
}

void MotorLeft() {
  if (CAR_STATE==CAR_LEFT)  return;
  CAR_STATE=CAR_LEFT;
  Serial.println("Motor::Left");
  digitalWrite(IN1, LOW);
  digitalWrite(IN2, LOW);
  digitalWrite(IN3, HIGH);
  digitalWrite(IN4, LOW);
  //MotorStop();
}

void MotorRight() {
  if (CAR_STATE==CAR_RIGHT)  return;
  CAR_STATE=CAR_RIGHT;
  Serial.println("Motor::Right");
  digitalWrite(IN1, LOW);
  digitalWrite(IN2, LOW);
  digitalWrite(IN3, LOW);
  digitalWrite(IN4, HIGH);
  //MotorStop();
}

void MotorStop() {
  if (CAR_STATE==CAR_STOP)  return;
  CAR_STATE=CAR_STOP;
  Serial.println("Motor::Stop");
  digitalWrite(IN1, LOW);
  digitalWrite(IN2, LOW);
  digitalWrite(IN3, LOW);
  digitalWrite(IN4, LOW);
}

void RedLight(bool status)
{
  return status ? digitalWrite(LED_RED, HIGH) : digitalWrite(LED_RED, LOW);
}

void BlueLight(bool status)
{
  return status ? digitalWrite(LED_BLUE, HIGH) : digitalWrite(LED_BLUE, LOW);
}

void YellowLight(bool status)
{
  return status ? digitalWrite(LED_YELLOW, HIGH) : digitalWrite(LED_YELLOW, LOW);
}

char cmd = 'S';
char prevCmd = 'A';
int velocity = 0;
unsigned long timer0 = 2000;  //Stores the time (in millis since execution started)
unsigned long timer1 = 0;     //Stores the time when the last command was received from the phone

void loop() {
  server.handleClient();

  delay(2);

  if (Serial.available()) {
    SerialBT.write(Serial.read());
  }
  if (SerialBT.available()) {
    timer1 = millis();
    prevCmd = cmd;
    cmd = SerialBT.read();
    //Change pin mode only if new command is different from previous.
    if(cmd!=prevCmd){

      Serial.write(cmd);
      switch(cmd)
      {
      case 'L' : MotorLeft();break;
      case 'R' : MotorRight();break;
      case 'B' : MotorUp();break;    // Reverse Backward
      case 'F' : MotorDown();break;  // Reverse Forward
      case 'X' : MotorStop();break;
      case 'x' : MotorStop();break;
      case 'W' : BlueLight(true);break;
      case 'w' : BlueLight(false);break;
      case 'U' : RedLight(true);break;
      case 'u' : RedLight(false);break;
      case 'V' : YellowLight(true);break;
      case 'v' : YellowLight(false);break;
      default : break;
      }
    }
  }
  delay(20);
}

static bool bRed=false;     // cmd=U
static bool bYellow=false;  // cmd=V
static bool bGreen=false;   // cmd=W  cmd=Y (all on) cmd=Z (all off)

void handleMoveRequest() {
  if (!server.hasArg("dir")) {
    server.send(404, "text / plain", "Move: undefined");
    return;
  }
  String direction = server.arg("dir");
  if (direction.equals("F")) {
    forward();
    server.send(200, "text / plain", "Move: forward");
  }
  else if (direction.equals("B")) {
    backward();
    server.send(200, "text / plain", "Move: backward");
  }
  else  if (direction.equals("S")) {
    stop_motors();
    server.send(200, "text / plain", "Move: stop");
  }
  else  if (direction.equals("L")) {
    turn_left();
    server.send(200, "text / plain", "Turn: Left");
  }
  else  if (direction.equals("R")) {
    turn_right();
    server.send(200, "text / plain", "Turn: Right");
  }
  else  if (direction.equals("W")) {
    bGreen = !bGreen;
    BlueLight(bGreen);
    server.send(200, "text / plain", "Turn: Right");
  }
  else  if (direction.equals("U")) {
    bRed = !bRed;
    RedLight(bRed);
    server.send(200, "text / plain", "Turn: Right");
  }
  else  if (direction.equals("V")) {
    bYellow = !bYellow;
    YellowLight(bYellow);
    server.send(200, "text / plain", "Turn: Right");
  }
  else  if (direction.equals("Y")) {
    bRed = bYellow = bGreen = true;
    RedLight(true);
    YellowLight(true);
    BlueLight(true);
    server.send(200, "text / plain", "Turn: Right");
  }
  else  if (direction.equals("Z")) {
    bRed = bYellow = bGreen = false;
    RedLight(false);
    YellowLight(false);
    BlueLight(false);
    server.send(200, "text / plain", "Turn: Right");
  }
  else {
    server.send(404, "text / plain", "Move: undefined");
  }
}

void handleActionRequest() {
  if (!server.hasArg("type")) {
    server.send(404, "text / plain", "Action: undefined");
    return;
  }
  String type = server.arg("type");
  if (type.equals("1")) {
    // TODO : Action 1
    stop_motors();
    server.send(200, "text / plain", "Action 1");
  }
  else if (type.equals("2")) {
    // TODO : Action 2
    server.send(200, "text / plain", "Action 2");
  }
  else if (type.equals("3")) {
    // TODO : Action 3
    BlueLight(true);
    server.send(200, "text / plain", "Action 3");
  }
  else if (type.equals("4")) {
    // TODO : Action 4
    BlueLight(false);
    server.send(200, "text / plain", "Action 4");
  }
  else if (type.equals("5")) {
    // TODO : Action 5
    RedLight(true);
    server.send(200, "text / plain", "Action 5");
  }
  else if (type.equals("6")) {
    // TODO : Action 6
    RedLight(false);
    server.send(200, "text / plain", "Action 6");
  }
  else if (type.equals("7")) {
    // TODO : Action 7
     YellowLight(true);
    server.send(200, "text / plain", "Action 7");
  }
  else if (type.equals("8")) {
    // TODO : Action 8
     YellowLight(false);
    server.send(200, "text / plain", "Action 8");
  }
  else {
    server.send(404, "text / plain", "Action: undefined");
  }
}

void handleNotFound() {
  server.send(404, "text / plain", "404: Not found");
}


void stop_motors() {
  Serial.println("Motor::stop");
  digitalWrite(IN1, LOW);
  digitalWrite(IN2, LOW);
  digitalWrite(IN3, LOW);
  digitalWrite(IN4, LOW);
}

void forward() {
  Serial.println("Motor::forward()");
  digitalWrite(IN1, LOW);
  digitalWrite(IN2, HIGH);
  digitalWrite(IN3, LOW);
  digitalWrite(IN4, HIGH);
}

void backward() {
  Serial.println("Motor::backward()");
  digitalWrite(IN1, HIGH);
  digitalWrite(IN2, LOW);
  digitalWrite(IN3, HIGH);
  digitalWrite(IN4, LOW);

}

void turn_left() {
  Serial.println("Motor::Left");
  digitalWrite(IN1, LOW);
  digitalWrite(IN2, LOW);
  digitalWrite(IN3, HIGH);
  digitalWrite(IN4, LOW);
}

void turn_right() {
  Serial.println("Motor::Right");
  digitalWrite(IN1, LOW);
  digitalWrite(IN2, LOW);
  digitalWrite(IN3, LOW);
  digitalWrite(IN4, HIGH);
}
